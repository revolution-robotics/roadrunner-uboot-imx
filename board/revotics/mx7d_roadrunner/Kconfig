## board/revotics/mx7d_roadrunner/Kconfig
```kconfig
if TARGET_MX7D_ROADRUNNER

config SYS_BOARD
	default "mx7d_roadrunner"

config SYS_VENDOR
	default "revotics"

config SYS_CONFIG_NAME
	default "mx7d_roadrunner"

endif
```
